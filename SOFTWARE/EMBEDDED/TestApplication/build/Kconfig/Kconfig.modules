## SOFTWARE/EMBEDDED/TestApplication/build/Kconfig/Kconfig.modules
```kconfig
menu "nrf (/home/bolobos/ncs/v3.1.1/nrf)"
osource "/home/bolobos/ncs/v3.1.1/nrf/Kconfig.nrf"
config ZEPHYR_NRF_MODULE
	bool
	default y
endmenu
menu "hostap (/home/bolobos/ncs/v3.1.1/modules/lib/hostap)"
osource "$(ZEPHYR_HOSTAP_KCONFIG)"
config ZEPHYR_HOSTAP_MODULE
	bool
	default y
endmenu
menu "mcuboot (/home/bolobos/ncs/v3.1.1/bootloader/mcuboot)"
osource "$(ZEPHYR_MCUBOOT_KCONFIG)"
config ZEPHYR_MCUBOOT_MODULE
	bool
	default y
endmenu
menu "mbedtls (/home/bolobos/ncs/v3.1.1/modules/crypto/mbedtls)"
osource "$(ZEPHYR_MBEDTLS_KCONFIG)"
config ZEPHYR_MBEDTLS_MODULE
	bool
	default y
endmenu
menu "oberon-psa-crypto (/home/bolobos/ncs/v3.1.1/modules/crypto/oberon-psa-crypto)"
osource "/home/bolobos/ncs/v3.1.1/modules/crypto/oberon-psa-crypto/Kconfig.oberon_psa_crypto"
config ZEPHYR_OBERON_PSA_CRYPTO_MODULE
	bool
	default y
endmenu
menu "trusted-firmware-m (/home/bolobos/ncs/v3.1.1/modules/tee/tf-m/trusted-firmware-m)"
osource "$(ZEPHYR_TRUSTED_FIRMWARE_M_KCONFIG)"
config ZEPHYR_TRUSTED_FIRMWARE_M_MODULE
	bool
	default y
endmenu
config ZEPHYR_PSA_ARCH_TESTS_MODULE
	bool
	default y
menu "cjson (/home/bolobos/ncs/v3.1.1/modules/lib/cjson)"
osource "$(ZEPHYR_CJSON_KCONFIG)"
config ZEPHYR_CJSON_MODULE
	bool
	default y
endmenu
menu "azure-sdk-for-c (/home/bolobos/ncs/v3.1.1/modules/lib/azure-sdk-for-c)"
osource "$(ZEPHYR_AZURE_SDK_FOR_C_KCONFIG)"
config ZEPHYR_AZURE_SDK_FOR_C_MODULE
	bool
	default y
endmenu
menu "cirrus-logic (/home/bolobos/ncs/v3.1.1/modules/hal/cirrus-logic)"
osource "/home/bolobos/ncs/v3.1.1/modules/hal/cirrus-logic/Kconfig"
config ZEPHYR_CIRRUS_LOGIC_MODULE
	bool
	default y
endmenu
menu "openthread (/home/bolobos/ncs/v3.1.1/modules/lib/openthread)"
osource "$(ZEPHYR_OPENTHREAD_KCONFIG)"
config ZEPHYR_OPENTHREAD_MODULE
	bool
	default y
endmenu
menu "memfault-firmware-sdk (/home/bolobos/ncs/v3.1.1/modules/lib/memfault-firmware-sdk)"
osource "/home/bolobos/ncs/v3.1.1/modules/lib/memfault-firmware-sdk/ports/zephyr/Kconfig"
config ZEPHYR_MEMFAULT_FIRMWARE_SDK_MODULE
	bool
	default y
endmenu
menu "coremark (/home/bolobos/ncs/v3.1.1/modules/benchmark/coremark)"
osource "$(ZEPHYR_COREMARK_KCONFIG)"
config ZEPHYR_COREMARK_MODULE
	bool
	default y
endmenu
menu "canopennode (/home/bolobos/ncs/v3.1.1/modules/lib/canopennode)"
osource "$(ZEPHYR_CANOPENNODE_KCONFIG)"
config ZEPHYR_CANOPENNODE_MODULE
	bool
	default y
endmenu
menu "chre (/home/bolobos/ncs/v3.1.1/modules/lib/chre)"
osource "/home/bolobos/ncs/v3.1.1/modules/lib/chre/platform/zephyr/Kconfig"
config ZEPHYR_CHRE_MODULE
	bool
	default y
endmenu
menu "lz4 (/home/bolobos/ncs/v3.1.1/modules/lib/lz4)"
osource "$(ZEPHYR_LZ4_KCONFIG)"
config ZEPHYR_LZ4_MODULE
	bool
	default y
endmenu
menu "nanopb (/home/bolobos/ncs/v3.1.1/modules/lib/nanopb)"
osource "$(ZEPHYR_NANOPB_KCONFIG)"
config ZEPHYR_NANOPB_MODULE
	bool
	default y
endmenu
config ZEPHYR_TF_M_TESTS_MODULE
	bool
	default y
menu "zscilib (/home/bolobos/ncs/v3.1.1/modules/lib/zscilib)"
osource "/home/bolobos/ncs/v3.1.1/modules/lib/zscilib/Kconfig.zscilib"
config ZEPHYR_ZSCILIB_MODULE
	bool
	default y
endmenu
menu "cmsis (/home/bolobos/ncs/v3.1.1/modules/hal/cmsis)"
osource "$(ZEPHYR_CMSIS_KCONFIG)"
config ZEPHYR_CMSIS_MODULE
	bool
	default y
endmenu
menu "cmsis-dsp (/home/bolobos/ncs/v3.1.1/modules/lib/cmsis-dsp)"
osource "$(ZEPHYR_CMSIS_DSP_KCONFIG)"
config ZEPHYR_CMSIS_DSP_MODULE
	bool
	default y
endmenu
menu "cmsis-nn (/home/bolobos/ncs/v3.1.1/modules/lib/cmsis-nn)"
osource "$(ZEPHYR_CMSIS_NN_KCONFIG)"
config ZEPHYR_CMSIS_NN_MODULE
	bool
	default y
endmenu
menu "cmsis_6 (/home/bolobos/ncs/v3.1.1/modules/hal/cmsis_6)"
osource "$(ZEPHYR_CMSIS_6_KCONFIG)"
config ZEPHYR_CMSIS_6_MODULE
	bool
	default y
endmenu
menu "fatfs (/home/bolobos/ncs/v3.1.1/modules/fs/fatfs)"
osource "$(ZEPHYR_FATFS_KCONFIG)"
config ZEPHYR_FATFS_MODULE
	bool
	default y
endmenu
menu "hal_nordic (/home/bolobos/ncs/v3.1.1/modules/hal/nordic)"
osource "$(ZEPHYR_HAL_NORDIC_KCONFIG)"
config ZEPHYR_HAL_NORDIC_MODULE
	bool
	default y

config ZEPHYR_HAL_NORDIC_MODULE_BLOBS
	bool
endmenu
menu "hal_st (/home/bolobos/ncs/v3.1.1/modules/hal/st)"
osource "$(ZEPHYR_HAL_ST_KCONFIG)"
config ZEPHYR_HAL_ST_MODULE
	bool
	default y
endmenu
menu "hal_tdk (/home/bolobos/ncs/v3.1.1/modules/hal/tdk)"
osource "$(ZEPHYR_HAL_TDK_KCONFIG)"
config ZEPHYR_HAL_TDK_MODULE
	bool
	default y
endmenu
config ZEPHYR_HAL_WURTHELEKTRONIK_MODULE
	bool
	default y
menu "liblc3 (/home/bolobos/ncs/v3.1.1/modules/lib/liblc3)"
osource "$(ZEPHYR_LIBLC3_KCONFIG)"
config ZEPHYR_LIBLC3_MODULE
	bool
	default y
endmenu
config ZEPHYR_LIBMETAL_MODULE
	bool
	default y
menu "littlefs (/home/bolobos/ncs/v3.1.1/modules/fs/littlefs)"
osource "$(ZEPHYR_LITTLEFS_KCONFIG)"
config ZEPHYR_LITTLEFS_MODULE
	bool
	default y
endmenu
menu "loramac-node (/home/bolobos/ncs/v3.1.1/modules/lib/loramac-node)"
osource "$(ZEPHYR_LORAMAC_NODE_KCONFIG)"
config ZEPHYR_LORAMAC_NODE_MODULE
	bool
	default y
endmenu
menu "lvgl (/home/bolobos/ncs/v3.1.1/modules/lib/gui/lvgl)"
osource "/home/bolobos/ncs/v3.1.1/modules/lib/gui/lvgl/zephyr/Kconfig"
config ZEPHYR_LVGL_MODULE
	bool
	default y
endmenu
config ZEPHYR_MIPI_SYS_T_MODULE
	bool
	default y
menu "nrf_wifi (/home/bolobos/ncs/v3.1.1/modules/lib/nrf_wifi)"
osource "$(ZEPHYR_NRF_WIFI_KCONFIG)"
config ZEPHYR_NRF_WIFI_MODULE
	bool
	default y

config ZEPHYR_NRF_WIFI_MODULE_BLOBS
	bool
endmenu
config ZEPHYR_OPEN_AMP_MODULE
	bool
	default y
menu "percepio (/home/bolobos/ncs/v3.1.1/modules/debug/percepio)"
osource "/home/bolobos/ncs/v3.1.1/modules/debug/percepio/zephyr/Kconfig"
config ZEPHYR_PERCEPIO_MODULE
	bool
	default y
endmenu
menu "picolibc (/home/bolobos/ncs/v3.1.1/modules/lib/picolibc)"
osource "/home/bolobos/ncs/v3.1.1/modules/lib/picolibc/zephyr/Kconfig"
config ZEPHYR_PICOLIBC_MODULE
	bool
	default y
endmenu
menu "segger (/home/bolobos/ncs/v3.1.1/modules/debug/segger)"
osource "$(ZEPHYR_SEGGER_KCONFIG)"
config ZEPHYR_SEGGER_MODULE
	bool
	default y
endmenu
config ZEPHYR_TINYCRYPT_MODULE
	bool
	default y
menu "uoscore-uedhoc (/home/bolobos/ncs/v3.1.1/modules/lib/uoscore-uedhoc)"
osource "$(ZEPHYR_UOSCORE_UEDHOC_KCONFIG)"
config ZEPHYR_UOSCORE_UEDHOC_MODULE
	bool
	default y
endmenu
menu "zcbor (/home/bolobos/ncs/v3.1.1/modules/lib/zcbor)"
osource "$(ZEPHYR_ZCBOR_KCONFIG)"
config ZEPHYR_ZCBOR_MODULE
	bool
	default y
endmenu
menu "nrfxlib (/home/bolobos/ncs/v3.1.1/nrfxlib)"
osource "/home/bolobos/ncs/v3.1.1/nrfxlib/Kconfig.nrfxlib"
config ZEPHYR_NRFXLIB_MODULE
	bool
	default y
endmenu
config ZEPHYR_NRF_HW_MODELS_MODULE
	bool
	default y
menu "connectedhomeip (/home/bolobos/ncs/v3.1.1/modules/lib/matter)"
osource "/home/bolobos/ncs/v3.1.1/modules/lib/matter/config/nrfconnect/chip-module/Kconfig"
config ZEPHYR_CONNECTEDHOMEIP_MODULE
	bool
	default y
endmenu
```

## SOFTWARE/EMBEDDED/TestApplication/build/Kconfig/arch/Kconfig
```kconfig
# Load Zephyr Arch Kconfig descriptions.
osource "/home/bolobos/ncs/v3.1.1/zephyr/arch/rx/Kconfig"
osource "/home/bolobos/ncs/v3.1.1/zephyr/arch/x86/Kconfig"
osource "/home/bolobos/ncs/v3.1.1/zephyr/arch/xtensa/Kconfig"
osource "/home/bolobos/ncs/v3.1.1/zephyr/arch/sparc/Kconfig"
osource "/home/bolobos/ncs/v3.1.1/zephyr/arch/riscv/Kconfig"
osource "/home/bolobos/ncs/v3.1.1/zephyr/arch/posix/Kconfig"
osource "/home/bolobos/ncs/v3.1.1/zephyr/arch/mips/Kconfig"
osource "/home/bolobos/ncs/v3.1.1/zephyr/arch/arm64/Kconfig"
osource "/home/bolobos/ncs/v3.1.1/zephyr/arch/arm/Kconfig"
osource "/home/bolobos/ncs/v3.1.1/zephyr/arch/arc/Kconfig"
```

## SOFTWARE/EMBEDDED/TestApplication/build/Kconfig/boards/Kconfig.sysbuild
```kconfig
# Load Sysbuild board Kconfig descriptions.
osource "/home/bolobos/ncs/v3.1.1/zephyr/boards/nordic/nrf5340dk/Kconfig.sysbuild"
```

## SOFTWARE/EMBEDDED/TestApplication/build/Kconfig/soc/Kconfig
```kconfig
# Load Zephyr SoC Kconfig descriptions.
osource "/home/bolobos/ncs/v3.1.1/zephyr/soc/xlnx/zynqmp/Kconfig"
osource "/home/bolobos/ncs/v3.1.1/zephyr/soc/xlnx/zynq7000/Kconfig"
osource "/home/bolobos/ncs/v3.1.1/zephyr/soc/xlnx/versalnet/Kconfig"
osource "/home/bolobos/ncs/v3.1.1/zephyr/soc/xlnx/versal2/Kconfig"
osource "/home/bolobos/ncs/v3.1.1/zephyr/soc/xen/Kconfig"
osource "/home/bolobos/ncs/v3.1.1/zephyr/soc/wch/ch32v/Kconfig"
osource "/home/bolobos/ncs/v3.1.1/zephyr/soc/ti/simplelink/Kconfig"
osource "/home/bolobos/ncs/v3.1.1/zephyr/soc/ti/mspm0/Kconfig"
osource "/home/bolobos/ncs/v3.1.1/zephyr/soc/ti/lm3s6965/Kconfig"
osource "/home/bolobos/ncs/v3.1.1/zephyr/soc/ti/k3/Kconfig"
osource "/home/bolobos/ncs/v3.1.1/zephyr/soc/telink/tlsr/Kconfig"
osource "/home/bolobos/ncs/v3.1.1/zephyr/soc/starfive/jh71xx/Kconfig"
osource "/home/bolobos/ncs/v3.1.1/zephyr/soc/st/stm32/Kconfig"
osource "/home/bolobos/ncs/v3.1.1/zephyr/soc/snps/qemu_arc/Kconfig"
osource "/home/bolobos/ncs/v3.1.1/zephyr/soc/snps/nsim/arc_v/Kconfig"
osource "/home/bolobos/ncs/v3.1.1/zephyr/soc/snps/nsim/arc_classic/Kconfig"
osource "/home/bolobos/ncs/v3.1.1/zephyr/soc/snps/hsdk4xd/Kconfig"
osource "/home/bolobos/ncs/v3.1.1/zephyr/soc/snps/hsdk/Kconfig"
osource "/home/bolobos/ncs/v3.1.1/zephyr/soc/snps/emsk/Kconfig"
osource "/home/bolobos/ncs/v3.1.1/zephyr/soc/snps/emsdp/Kconfig"
osource "/home/bolobos/ncs/v3.1.1/zephyr/soc/snps/arc_iot/Kconfig"
osource "/home/bolobos/ncs/v3.1.1/zephyr/soc/silabs/Kconfig"
osource "/home/bolobos/ncs/v3.1.1/zephyr/soc/sifive/sifive_freedom/Kconfig"
osource "/home/bolobos/ncs/v3.1.1/zephyr/soc/sensry/Kconfig"
osource "/home/bolobos/ncs/v3.1.1/zephyr/soc/rockchip/Kconfig"
osource "/home/bolobos/ncs/v3.1.1/zephyr/soc/renode/riscv_virtual/Kconfig"
osource "/home/bolobos/ncs/v3.1.1/zephyr/soc/renode/cortex_r8_virtual/Kconfig"
osource "/home/bolobos/ncs/v3.1.1/zephyr/soc/renesas/smartbond/Kconfig"
osource "/home/bolobos/ncs/v3.1.1/zephyr/soc/renesas/rz/Kconfig"
osource "/home/bolobos/ncs/v3.1.1/zephyr/soc/renesas/rx/Kconfig"
osource "/home/bolobos/ncs/v3.1.1/zephyr/soc/renesas/rcar/Kconfig"
osource "/home/bolobos/ncs/v3.1.1/zephyr/soc/renesas/ra/Kconfig"
osource "/home/bolobos/ncs/v3.1.1/zephyr/soc/realtek/ec/Kconfig"
osource "/home/bolobos/ncs/v3.1.1/zephyr/soc/raspberrypi/rpi_pico/Kconfig"
osource "/home/bolobos/ncs/v3.1.1/zephyr/soc/quicklogic/eos_s3/Kconfig"
osource "/home/bolobos/ncs/v3.1.1/zephyr/soc/qemu/virt_riscv/Kconfig"
osource "/home/bolobos/ncs/v3.1.1/zephyr/soc/qemu/malta/Kconfig"
osource "/home/bolobos/ncs/v3.1.1/zephyr/soc/openisa/rv32m1/Kconfig"
osource "/home/bolobos/ncs/v3.1.1/zephyr/soc/openhwgroup/cva6/Kconfig"
osource "/home/bolobos/ncs/v3.1.1/zephyr/soc/oct/osd32mp15x/Kconfig"
osource "/home/bolobos/ncs/v3.1.1/zephyr/soc/nxp/s32/Kconfig"
osource "/home/bolobos/ncs/v3.1.1/zephyr/soc/nxp/rw/Kconfig"
osource "/home/bolobos/ncs/v3.1.1/zephyr/soc/nxp/mcx/Kconfig"
osource "/home/bolobos/ncs/v3.1.1/zephyr/soc/nxp/lpc/Kconfig"
osource "/home/bolobos/ncs/v3.1.1/zephyr/soc/nxp/layerscape/Kconfig"
osource "/home/bolobos/ncs/v3.1.1/zephyr/soc/nxp/kinetis/Kconfig"
osource "/home/bolobos/ncs/v3.1.1/zephyr/soc/nxp/imxrt/Kconfig"
osource "/home/bolobos/ncs/v3.1.1/zephyr/soc/nxp/imx/Kconfig"
osource "/home/bolobos/ncs/v3.1.1/zephyr/soc/nuvoton/numicro/Kconfig"
osource "/home/bolobos/ncs/v3.1.1/zephyr/soc/nuvoton/numaker/Kconfig"
osource "/home/bolobos/ncs/v3.1.1/zephyr/soc/nuvoton/npcx/Kconfig"
osource "/home/bolobos/ncs/v3.1.1/zephyr/soc/nuvoton/npcm/Kconfig"
osource "/home/bolobos/ncs/v3.1.1/zephyr/soc/nordic/Kconfig"
osource "/home/bolobos/ncs/v3.1.1/zephyr/soc/neorv32/Kconfig"
osource "/home/bolobos/ncs/v3.1.1/zephyr/soc/native/inf_clock/Kconfig"
osource "/home/bolobos/ncs/v3.1.1/zephyr/soc/microchip/sam/Kconfig"
osource "/home/bolobos/ncs/v3.1.1/zephyr/soc/microchip/miv/Kconfig"
osource "/home/bolobos/ncs/v3.1.1/zephyr/soc/microchip/mec/Kconfig"
osource "/home/bolobos/ncs/v3.1.1/zephyr/soc/mediatek/mt8xxx/Kconfig"
osource "/home/bolobos/ncs/v3.1.1/zephyr/soc/lowrisc/opentitan/Kconfig"
osource "/home/bolobos/ncs/v3.1.1/zephyr/soc/litex/litex_vexriscv/Kconfig"
osource "/home/bolobos/ncs/v3.1.1/zephyr/soc/ite/ec/Kconfig"
osource "/home/bolobos/ncs/v3.1.1/zephyr/soc/intel/raptor_lake/Kconfig"
osource "/home/bolobos/ncs/v3.1.1/zephyr/soc/intel/lakemont/Kconfig"
osource "/home/bolobos/ncs/v3.1.1/zephyr/soc/intel/intel_socfpga_std/Kconfig"
osource "/home/bolobos/ncs/v3.1.1/zephyr/soc/intel/intel_socfpga/Kconfig"
osource "/home/bolobos/ncs/v3.1.1/zephyr/soc/intel/intel_niosv/Kconfig"
osource "/home/bolobos/ncs/v3.1.1/zephyr/soc/intel/intel_ish/Kconfig"
osource "/home/bolobos/ncs/v3.1.1/zephyr/soc/intel/intel_adsp/Kconfig"
osource "/home/bolobos/ncs/v3.1.1/zephyr/soc/intel/elkhart_lake/Kconfig"
osource "/home/bolobos/ncs/v3.1.1/zephyr/soc/intel/atom/Kconfig"
osource "/home/bolobos/ncs/v3.1.1/zephyr/soc/intel/apollo_lake/Kconfig"
osource "/home/bolobos/ncs/v3.1.1/zephyr/soc/intel/alder_lake/Kconfig"
osource "/home/bolobos/ncs/v3.1.1/zephyr/soc/infineon/cat3/Kconfig"
osource "/home/bolobos/ncs/v3.1.1/zephyr/soc/infineon/cat1c/Kconfig"
osource "/home/bolobos/ncs/v3.1.1/zephyr/soc/infineon/cat1b/Kconfig"
osource "/home/bolobos/ncs/v3.1.1/zephyr/soc/infineon/cat1a/Kconfig"
osource "/home/bolobos/ncs/v3.1.1/zephyr/soc/gd/gd32/Kconfig"
osource "/home/bolobos/ncs/v3.1.1/zephyr/soc/gaisler/leon3/Kconfig"
osource "/home/bolobos/ncs/v3.1.1/zephyr/soc/gaisler/gr716a/Kconfig"
osource "/home/bolobos/ncs/v3.1.1/zephyr/soc/espressif/Kconfig"
osource "/home/bolobos/ncs/v3.1.1/zephyr/soc/ene/kb1200/Kconfig"
osource "/home/bolobos/ncs/v3.1.1/zephyr/soc/efinix/sapphire/Kconfig"
osource "/home/bolobos/ncs/v3.1.1/zephyr/soc/cdns/xtensa_sample_controller/Kconfig"
osource "/home/bolobos/ncs/v3.1.1/zephyr/soc/cdns/sample_controller32/Kconfig"
osource "/home/bolobos/ncs/v3.1.1/zephyr/soc/cdns/dc233c/Kconfig"
osource "/home/bolobos/ncs/v3.1.1/zephyr/soc/brcm/bcmvk/Kconfig"
osource "/home/bolobos/ncs/v3.1.1/zephyr/soc/brcm/bcm2712/Kconfig"
osource "/home/bolobos/ncs/v3.1.1/zephyr/soc/brcm/bcm2711/Kconfig"
osource "/home/bolobos/ncs/v3.1.1/zephyr/soc/bflb/Kconfig"
osource "/home/bolobos/ncs/v3.1.1/zephyr/soc/atmel/sam0/Kconfig"
osource "/home/bolobos/ncs/v3.1.1/zephyr/soc/atmel/sam/Kconfig"
osource "/home/bolobos/ncs/v3.1.1/zephyr/soc/aspeed/Kconfig"
osource "/home/bolobos/ncs/v3.1.1/zephyr/soc/arm/Kconfig"
osource "/home/bolobos/ncs/v3.1.1/zephyr/soc/arm/beetle/Kconfig"
osource "/home/bolobos/ncs/v3.1.1/zephyr/soc/antmicro/myra/Kconfig"
osource "/home/bolobos/ncs/v3.1.1/zephyr/soc/andestech/Kconfig"
osource "/home/bolobos/ncs/v3.1.1/zephyr/soc/amd/acp_6_0/Kconfig"
osource "/home/bolobos/ncs/v3.1.1/zephyr/soc/ambiq/Kconfig"
osource "/home/bolobos/ncs/v3.1.1/zephyr/soc/aesc/Kconfig"
osource "/home/bolobos/ncs/v3.1.1/zephyr/soc/adi/max32/Kconfig"
osource "/home/bolobos/ncs/v3.1.1/nrf/soc/sercomm/nrf91/Kconfig"
osource "/home/bolobos/ncs/v3.1.1/nrf/soc/nordic/Kconfig"
```

## SOFTWARE/EMBEDDED/TestApplication/build/ipc_radio/Kconfig/boards/Kconfig.defconfig
```kconfig
# Load Zephyr board defconfig descriptions.
osource "/home/bolobos/ncs/v3.1.1/zephyr/boards/nordic/nrf5340dk/Kconfig.defconfig"
```
